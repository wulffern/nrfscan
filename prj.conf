## CMakeLists.txt
```
######################################################################
##        Copyright (c) 2026 Carsten Wulff Software, Norway
######################################################################

cmake_minimum_required(VERSION 3.20.0)

find_package(Zephyr REQUIRED HINTS $ENV{ZEPHYR_BASE})
project(nrfscan)

# Defaults; overridden by -DSCAN_* from `make` / `west build` via sysbuild cache.
set(SCAN_INTERVAL_MS 1000)
set(SCAN_SETTLE_US 2)
set(SCAN_DISABLE_PERIOD_CH 10)
set(SCAN_RADIO_2MBIT 1)
zephyr_get(SCAN_INTERVAL_MS)
zephyr_get(SCAN_SETTLE_US)
zephyr_get(SCAN_DISABLE_PERIOD_CH)
zephyr_get(SCAN_RADIO_2MBIT)

if(CONFIG_SOC_SERIES_NRF54L)
  set(NRFSCAN_SOC_NRF54 1)
else()
  set(NRFSCAN_SOC_NRF54 0)
endif()

target_compile_definitions(app PRIVATE
  SCAN_INTERVAL_MS=${SCAN_INTERVAL_MS}
  SCAN_SETTLE_US=${SCAN_SETTLE_US}
  SCAN_DISABLE_PERIOD_CH=${SCAN_DISABLE_PERIOD_CH}
  SCAN_RADIO_2MBIT=${SCAN_RADIO_2MBIT}
  NRFSCAN_SOC_NRF54=${NRFSCAN_SOC_NRF54}
)
target_sources(app PRIVATE
  src/main.c
  src/hal_radio_common.c
  src/hal_platform.c
)
if(CONFIG_SOC_SERIES_NRF54L)
  target_sources(app PRIVATE src/hal_radio_nrf54.c)
else()
  target_sources(app PRIVATE src/hal_radio_nrf52.c)
endif()
```

## prj.conf
```kconfig
CONFIG_SERIAL=n
CONFIG_UART_CONSOLE=n
CONFIG_GPIO=y
CONFIG_NRFX_UARTE=y
CONFIG_MAIN_STACK_SIZE=4096

# nRF54: no periodic sys tick during long WFE gaps; wake on next timer event only.
CONFIG_TICKLESS_KERNEL=y
```

## src/main.c
```c
/*********************************************************************
 *  nrfscan: sweep RSSI on all BLE channels, JSON on UART every 1 s.
 *********************************************************************/

#include "hal_platform.h"
#include "hal_radio.h"
#include "hal_soc.h"
#include <mdk/nrf.h>
#include <nrfx_uarte.h>
#include <stdint.h>

#ifndef SCAN_INTERVAL_MS
#define SCAN_INTERVAL_MS 1000
#endif

#ifndef SCAN_SETTLE_US
#define SCAN_SETTLE_US 10
#endif

#ifndef SCAN_DISABLE_PERIOD_CH
#define SCAN_DISABLE_PERIOD_CH 10
#endif

static nrfx_uarte_t uart = NRFX_UARTE_INSTANCE(HAL_UARTE_INST);

static void uart_init(void)
{
    nrfx_uarte_config_t config = NRFX_UARTE_DEFAULT_CONFIG(TXD_PIN, RXD_PIN);
    config.baudrate = NRF_UARTE_BAUDRATE_115200;
    (void)nrfx_uarte_init(&uart, &config, NULL);
}

static void uart_put_char(uint8_t ch)
{
    nrfx_uarte_tx(&uart, &ch, 1, NRFX_UARTE_TX_BLOCKING);
}

static void uart_put_string(const char *string)
{
    while (*string != '\0') {
        uart_put_char(*string++);
    }
}

static void uart_put_int(int value)
{
    char buf[12];
    int idx = 0;
    bool neg = false;

    if (value < 0) {
        neg = true;
        value = -value;
    }
    if (value == 0) {
        uart_put_char('0');
        return;
    }
    while (value > 0 && idx < (int)sizeof(buf)) {
        buf[idx++] = (char)('0' + (value % 10));
        value /= 10;
    }
    if (neg) {
        uart_put_char('-');
    }
    while (idx > 0) {
        uart_put_char((uint8_t)buf[--idx]);
    }
}

static void int_to_json(const char *key, int value)
{
    uart_put_string("\"");
    uart_put_string(key);
    uart_put_string("\" : ");
    uart_put_int(value);
}

static void int8_array_to_json(const char *key, const int8_t *array, uint32_t length)
{
    uart_put_string("\"");
    uart_put_string(key);
    uart_put_string("\":[");
    for (uint32_t i = 0; i < length; i++) {
        uart_put_int((int)array[i]);
        if ((i + 1) < length) {
            uart_put_string(",");
        }
    }
    uart_put_string("]");
}

static void scan_report_to_json(const int8_t *rssi_dbm, uint32_t scan_duration_us,
                                const hal_radio_scan_timing_t *timing, uint32_t scan_count)
{
    const uint32_t sweep_accounted = timing->hfclk_us + timing->disable_us + timing->ready_us +
                                     timing->settle_us + timing->rssi_us + timing->final_disable_us;

    uart_put_string("{");
    int8_array_to_json("rssi_dB", rssi_dbm, RSSI_CHANNEL_COUNT);
    uart_put_string(",");
    int_to_json("scan_duration_us", (int)scan_duration_us);
    uart_put_char(',');
    int_to_json("time_hfclk_us", (int)timing->hfclk_us);
    uart_put_char(',');
    int_to_json("time_ready_us", (int)timing->ready_us);
    uart_put_char(',');
    int_to_json("time_disable_us", (int)timing->disable_us);
    uart_put_char(',');
    int_to_json("time_settle_us", (int)timing->settle_us);
    uart_put_char(',');
    int_to_json("time_rssi_us", (int)timing->rssi_us);
    uart_put_char(',');
    int_to_json("time_final_disable_us", (int)timing->final_disable_us);
    uart_put_char(',');
    int_to_json("time_other_us", (int)(scan_duration_us - sweep_accounted));
    uart_put_char(',');
    int_to_json("count_ready", (int)timing->ready_count);
    uart_put_char(',');
    int_to_json("count_disable", (int)timing->disable_count);
    uart_put_char(',');
    int_to_json("channels", RSSI_CHANNEL_COUNT);
    uart_put_char(',');
    int_to_json("freq_base_mhz", RSSI_FREQ_BASE_MHZ);
    uart_put_char(',');
    int_to_json("freq_step_mhz", RSSI_FREQ_STEP_MHZ);
    uart_put_char(',');
    int_to_json("interval_ms", SCAN_INTERVAL_MS);
    uart_put_char(',');
    int_to_json("settle_us", SCAN_SETTLE_US);
    uart_put_char(',');
    int_to_json("disable_period_ch", SCAN_DISABLE_PERIOD_CH);
    uart_put_char(',');
    int_to_json("radio_2mbit", SCAN_RADIO_2MBIT);
    uart_put_char(',');
    int_to_json("scan_count", (int)scan_count);
    uart_put_string("}\n\r");
}

static void run_one_scan(int8_t *rssi_dbm, uint32_t *duration_us, hal_radio_scan_timing_t *timing)
{
    const uint32_t scan_start = hal_time_us();

    hal_radio_scan_rssi(rssi_dbm, timing);
    *duration_us = hal_time_us() - scan_start;
}

int main(void)
{
    int8_t rssi_dbm[RSSI_CHANNEL_COUNT];
    uint32_t scan_count = 0;

    hal_dcdc_enable();
    uart_init();
    hal_timer_init();
    hal_radio_init();
    hal_interval_init();

    while (1) {
        uint32_t duration_us = 0;
        hal_radio_scan_timing_t timing;

        scan_count++;
        run_one_scan(rssi_dbm, &duration_us, &timing);
        scan_report_to_json(rssi_dbm, duration_us, &timing, scan_count);

        hal_interval_wait_ms(SCAN_INTERVAL_MS);
    }

    return 0;
}
```

## src/hal_platform.c
```c
/*********************************************************************
 *  Bare-metal LFCLK, HFXO/HFCLK, interval sleep (RTC2 or GRTC + WFE).
 *
 *  Built as a Zephyr app: IRQ_CONNECT wires compare ISRs into the vector
 *  table.  On nRF54 one GRTC compare (z_nrf_grtc_timer) wakes us; with
 *  CONFIG_TICKLESS_KERNEL Zephyr does not schedule periodic sys ticks.
 ********************************************************************/

#include "hal_platform.h"
#include "hal_soc.h"
#include <mdk/nrf.h>
#include <stdbool.h>
#include <zephyr/irq.h>

#if NRFSCAN_SOC_NRF54
#include <zephyr/drivers/timer/nrf_grtc_timer.h>
#include <zephyr/kernel.h>
#endif

#define RTC_TICKS_PER_SEC 32768U
#define RTC_COUNTER_MASK  0xFFFFFFU
#define RTC_CC_CHANNEL    0

#define CLOCK_SPIN_LIMIT  5000000U

static volatile bool interval_wake;

static inline void cpu_wfe(void)
{
    __WFE();
    __SEV();
    __WFE();
}

#if NRFSCAN_SOC_NRF54

static bool clock_xo_running(void)
{
    return (NRF_CLOCK->XO.STAT & CLOCK_XO_STAT_STATE_Msk) ==
           (CLOCK_XO_STAT_STATE_Running << CLOCK_XO_STAT_STATE_Pos);
}

static bool lfclk_ready;

static int32_t grtc_interval_chan = -1;

static void grtc_interval_compare_isr(int32_t chan, uint64_t expire_time, void *user_data)
{
    ARG_UNUSED(chan);
    ARG_UNUSED(expire_time);
    ARG_UNUSED(user_data);

    interval_wake = true;
}

#else

static uint32_t rtc_ms_to_ticks(uint32_t ms)
{
    return (RTC_TICKS_PER_SEC * ms) / 1000U;
}

static uint32_t rtc_ticks_delta(uint32_t from, uint32_t to)
{
    return (to - from) & RTC_COUNTER_MASK;
}

static void rtc_schedule_compare_after(uint32_t ticks)
{
    uint32_t now = NRF_RTC2->COUNTER;
    uint32_t target = (now + ticks) & RTC_COUNTER_MASK;

    while (rtc_ticks_delta(now, target) > ticks) {
        now = NRF_RTC2->COUNTER;
        target = (now + ticks) & RTC_COUNTER_MASK;
    }

    interval_wake = false;
    NRF_RTC2->EVENTS_COMPARE[RTC_CC_CHANNEL] = 0;
    NRF_RTC2->CC[RTC_CC_CHANNEL] = target;
    NRF_RTC2->INTENSET = RTC_INTENSET_COMPARE0_Msk;
}

static void rtc2_compare_isr(const void *arg)
{
    ARG_UNUSED(arg);

    if (NRF_RTC2->EVENTS_COMPARE[RTC_CC_CHANNEL] == 0) {
        return;
    }

    NRF_RTC2->EVENTS_COMPARE[RTC_CC_CHANNEL] = 0;
    NRF_RTC2->INTENCLR = RTC_INTENCLR_COMPARE0_Msk;
    interval_wake = true;
}

#endif

void hal_dcdc_enable(void)
{
#if NRFSCAN_SOC_NRF54
    NRF_REGULATORS->VREGMAIN.DCDCEN =
        REGULATORS_VREGMAIN_DCDCEN_VAL_Enabled << REGULATORS_VREGMAIN_DCDCEN_VAL_Pos;
#else
    NRF_POWER->DCDCEN = 1;
#endif
}

void hal_clock_hfclk_start(void)
{
#if NRFSCAN_SOC_NRF54
    uint32_t spin;

    if (clock_xo_running()) {
        return;
    }

    NRF_CLOCK->EVENTS_XOSTARTED = 0;
    NRF_CLOCK->TASKS_XOSTART = CLOCK_TASKS_XOSTART_TASKS_XOSTART_Trigger;
    for (spin = 0; spin < CLOCK_SPIN_LIMIT && NRF_CLOCK->EVENTS_XOSTARTED == 0; spin++) {
    }
    NRF_CLOCK->EVENTS_XOSTARTED = 0;
#else
    NRF_CLOCK->EVENTS_HFCLKSTARTED = 0;
    NRF_CLOCK->TASKS_HFCLKSTART = 1;
    while (NRF_CLOCK->EVENTS_HFCLKSTARTED == 0) {
    }
    NRF_CLOCK->EVENTS_HFCLKSTARTED = 0;
#endif
}

void hal_clock_hfclk_stop(void)
{
#if NRFSCAN_SOC_NRF54
    uint32_t spin;

    if (!clock_xo_running()) {
        return;
    }

    NRF_CLOCK->TASKS_XOSTOP = CLOCK_TASKS_XOSTOP_TASKS_XOSTOP_Trigger;
    for (spin = 0; spin < CLOCK_SPIN_LIMIT && clock_xo_running(); spin++) {
    }
#else
    NRF_CLOCK->TASKS_HFCLKSTOP = 1;
#endif
}

void hal_lfclk_start(void)
{
#if NRFSCAN_SOC_NRF54
    if (lfclk_ready) {
        return;
    }

    NRF_CLOCK->LFCLK.SRC =
        (CLOCK_LFCLK_SRC_SRC_LFRC << CLOCK_LFCLK_SRC_SRC_Pos) & CLOCK_LFCLK_SRC_SRC_Msk;
    NRF_CLOCK->LFCLK.SRCCOPY = NRF_CLOCK->LFCLK.SRC;
    NRF_CLOCK->EVENTS_LFCLKSTARTED = 0;
    NRF_CLOCK->TASKS_LFCLKSTART = CLOCK_TASKS_LFCLKSTART_TASKS_LFCLKSTART_Trigger;
    while (NRF_CLOCK->EVENTS_LFCLKSTARTED == 0) {
    }
    NRF_CLOCK->EVENTS_LFCLKSTARTED = 0;
    lfclk_ready = true;
#else
    if ((NRF_CLOCK->LFCLKSTAT & CLOCK_LFCLKSTAT_STATE_Msk) ==
        (CLOCK_LFCLKSTAT_STATE_Running << CLOCK_LFCLKSTAT_STATE_Pos)) {
        return;
    }

    NRF_CLOCK->LFCLKSRC = CLOCK_LFCLKSRC_SRC_RC << CLOCK_LFCLKSRC_SRC_Pos;
    NRF_CLOCK->EVENTS_LFCLKSTARTED = 0;
    NRF_CLOCK->TASKS_LFCLKSTART = 1;
    while (NRF_CLOCK->EVENTS_LFCLKSTARTED == 0) {
    }
    NRF_CLOCK->EVENTS_LFCLKSTARTED = 0;
#endif
}

void hal_interval_init(void)
{
    hal_lfclk_start();

#if NRFSCAN_SOC_NRF54
    if (grtc_interval_chan < 0) {
        grtc_interval_chan = z_nrf_grtc_timer_chan_alloc();
    }
#else
    NRF_RTC2->TASKS_STOP = 1;
    NRF_RTC2->TASKS_CLEAR = 1;
    NRF_RTC2->PRESCALER = 0;
    NRF_RTC2->EVTENCLR = 0xFFFFFFFF;
    NRF_RTC2->INTENCLR = 0xFFFFFFFF;
    NRF_RTC2->EVENTS_COMPARE[RTC_CC_CHANNEL] = 0;
    NRF_RTC2->TASKS_START = 1;

    interval_wake = false;
    IRQ_CONNECT(RTC2_IRQn, 6, rtc2_compare_isr, NULL, 0);
    irq_enable(RTC2_IRQn);
#endif
}

void hal_interval_wait_ms(uint32_t ms)
{
#if NRFSCAN_SOC_NRF54
    const uint64_t target = z_nrf_grtc_timer_get_ticks(K_MSEC(ms));

    if (grtc_interval_chan < 0) {
        return;
    }

    interval_wake = false;
    z_nrf_grtc_timer_abort(grtc_interval_chan);
    if (z_nrf_grtc_timer_set(grtc_interval_chan, target, grtc_interval_compare_isr, NULL) != 0) {
        return;
    }

    while (!interval_wake) {
        cpu_wfe();
    }

    z_nrf_grtc_timer_abort(grtc_interval_chan);
#else
    const uint32_t ticks = rtc_ms_to_ticks(ms);

    rtc_schedule_compare_after(ticks);
    while (!interval_wake) {
        cpu_wfe();
    }
    interval_wake = false;
#endif
}
```

## src/hal_platform.h
```c
#ifndef HAL_PLATFORM_H__
#define HAL_PLATFORM_H__

#include <stdint.h>

void hal_dcdc_enable(void);
void hal_clock_hfclk_start(void);
void hal_clock_hfclk_stop(void);
void hal_lfclk_start(void);
void hal_interval_init(void);
void hal_interval_wait_ms(uint32_t ms);

#endif
```

## src/hal_radio.c
```c
/*********************************************************************
 *  RSSI sweep: FREQ -> RXEN -> settle -> RSSI.
 *  nRF52: periodic DISABLE+RXEN every SCAN_DISABLE_PERIOD_CH bins.
 *  nRF54: per bin FREQUENCY + PLLEN + PLLREADY_RXEN + RXREADY (nRF54LM20).
 ********************************************************************/

#include "hal_radio.h"
#include "hal_soc.h"
#include <mdk/nrf.h>
#include <stdbool.h>

#define DD_MAX_PAYLOAD_LENGTH (31 + 6)

#define RADIO_SHORTS_HOP (RADIO_SHORTS_DISABLED_RXEN_Enabled << RADIO_SHORTS_DISABLED_RXEN_Pos)

#if NRFSCAN_SOC_NRF54
#define RADIO_SHORTS_PLL_HOP                                                                   \
    (RADIO_SHORTS_PLLREADY_RXEN_Enabled << RADIO_SHORTS_PLLREADY_RXEN_Pos)
/* PLL reload + fast 2M RX ramp (~41 us); margin for both. */
#define RADIO_PLLREADY_TIMEOUT_US 150u
#define RADIO_RXREADY_TIMEOUT_US  150u
#endif

#define CRC_POLYNOMIAL_INIT_SETTINGS ((0x5B << 0) | (0x06 << 8) | (0x00 << 16))

#ifndef SCAN_SETTLE_US
#define SCAN_SETTLE_US 10
#endif

#ifndef SCAN_DISABLE_PERIOD_CH
#define SCAN_DISABLE_PERIOD_CH 10
#endif

#if SCAN_RADIO_2MBIT
#define RADIO_MODE_SCAN ((RADIO_MODE_MODE_Ble_2Mbit) << RADIO_MODE_MODE_Pos)
#else
#define RADIO_MODE_SCAN ((RADIO_MODE_MODE_Ble_1Mbit) << RADIO_MODE_MODE_Pos)
#endif

#define RADIO_EVENT_TIMEOUT_US 2000u

#if NRFSCAN_SOC_NRF54
/* Zephyr BLE controller radio_reset() values (radio_nrf54lx.h). */
#define RADIO_DATAWHITE_IV  0x00890040UL
#define RADIO_PCNF1_RESET   0x00000000UL
#define RADIO_SETTLE_US     ((SCAN_SETTLE_US < 100) ? 100U : (uint32_t)SCAN_SETTLE_US)
#define RADIO_RSSI_SAMPLES  3u
#else
#define RADIO_SETTLE_US     ((uint32_t)SCAN_SETTLE_US)
#endif

static const uint8_t access_address[4] = {0xD6, 0xBE, 0x89, 0x8E};
static const uint8_t crc_seed[3] = {0x55, 0x55, 0x55};

static uint8_t rx_packet[DD_MAX_PAYLOAD_LENGTH];

static void radio_channel_set(uint8_t channel_index)
{
    NRF_RADIO->FREQUENCY = channel_index;
#if NRFSCAN_SOC_NRF54
    NRF_RADIO->DATAWHITE = RADIO_DATAWHITE_IV;
#else
    NRF_RADIO->DATAWHITEIV = 0;
#endif
}

static int8_t rssi_sample_dbm(void)
{
    uint8_t sample = (uint8_t)((NRF_RADIO->RSSISAMPLE & RADIO_RSSISAMPLE_RSSISAMPLE_Msk) >>
                               RADIO_RSSISAMPLE_RSSISAMPLE_Pos);
    return (int8_t)(-(int8_t)sample);
}

static void wait_us(uint32_t us)
{
    uint32_t start = hal_time_us();

    while ((uint32_t)(hal_time_us() - start) < us) {
    }
}

static bool radio_wait_event(volatile uint32_t *event, uint32_t timeout_us)
{
    uint32_t start = hal_time_us();

    while (*event == 0) {
        if ((uint32_t)(hal_time_us() - start) > timeout_us) {
            return false;
        }
    }
    *event = 0;
    return true;
}

#if NRFSCAN_SOC_NRF54
static int8_t radio_rssi_sample_max(void)
{
    int8_t best = (int8_t)-127;

    for (uint32_t n = 0; n < RADIO_RSSI_SAMPLES; n++) {
        NRF_RADIO->TASKS_RSSISTART = 1;
        wait_us(5);
        const int8_t rssi = rssi_sample_dbm();
        if (rssi > best) {
            best = rssi;
        }
    }
    return best;
}
#endif

static int8_t radio_rssi_sample(void)
{
#if NRFSCAN_SOC_NRF54
    return radio_rssi_sample_max();
#else
    NRF_RADIO->EVENTS_RSSIEND = 0;
    NRF_RADIO->TASKS_RSSISTART = 1;
    if (!radio_wait_event(&NRF_RADIO->EVENTS_RSSIEND, RADIO_EVENT_TIMEOUT_US)) {
        return (int8_t)-127;
    }
    return rssi_sample_dbm();
#endif
}

/** DISABLE, then RXEN via DISABLED_RXEN short (FREQUENCY must be set first). */
static void radio_disable_rxen(void)
{
    NRF_RADIO->SHORTS = RADIO_SHORTS_HOP;
    NRF_RADIO->EVENTS_DISABLED = 0;
    NRF_RADIO->TASKS_DISABLE = 1;
    (void)radio_wait_event(&NRF_RADIO->EVENTS_DISABLED, RADIO_EVENT_TIMEOUT_US);
    NRF_RADIO->SHORTS = 0;
}

#if NRFSCAN_SOC_NRF54

static void radio_constlat_enable(void)
{
    NRF_POWER->TASKS_CONSTLAT = 1;
}

static bool radio_pll_reload_rxen(hal_radio_scan_timing_t *timing)
{
    uint32_t t0;

    NRF_RADIO->SHORTS = RADIO_SHORTS_PLL_HOP;
    NRF_RADIO->EVENTS_PLLREADY = 0;
    NRF_RADIO->EVENTS_RXREADY = 0;

    t0 = hal_time_us();
    NRF_RADIO->TASKS_PLLEN = 1;
    if (!radio_wait_event(&NRF_RADIO->EVENTS_PLLREADY, RADIO_PLLREADY_TIMEOUT_US)) {
        NRF_RADIO->SHORTS = 0;
        timing->ready_us += hal_time_us() - t0;
        timing->ready_count++;
        return false;
    }
    timing->ready_us += hal_time_us() - t0;
    timing->ready_count++;

    NRF_RADIO->SHORTS = 0;

    t0 = hal_time_us();
    if (!radio_wait_event(&NRF_RADIO->EVENTS_RXREADY, RADIO_RXREADY_TIMEOUT_US)) {
        timing->ready_us += hal_time_us() - t0;
        timing->ready_count++;
        return false;
    }
    timing->ready_us += hal_time_us() - t0;
    timing->ready_count++;
    return true;
}

/** FREQUENCY -> PLLEN (reload) -> PLLREADY -> RXEN -> RXREADY -> settle -> RSSI. */
static int8_t radio_measure_channel_nrf54(uint8_t channel, hal_radio_scan_timing_t *timing)
{
    uint32_t t0;

    radio_channel_set(channel);

    if (!radio_pll_reload_rxen(timing)) {
        return (int8_t)-127;
    }

    t0 = hal_time_us();
    wait_us(RADIO_SETTLE_US);
    timing->settle_us += hal_time_us() - t0;

    /* LL DTM/RX: receiver active before RSSISTART (instant sample on nRF54). */
    NRF_RADIO->TASKS_START = 1;
    wait_us(30);

    t0 = hal_time_us();
    const int8_t rssi = radio_rssi_sample();
    timing->rssi_us += hal_time_us() - t0;

    NRF_RADIO->TASKS_STOP = 1;
    return rssi;
}

#else

static int8_t radio_measure_channel(uint8_t channel, bool disable_first, bool wait_ready,
                                    hal_radio_scan_timing_t *timing)
{
    uint32_t t0;

    radio_channel_set(channel);

    if (disable_first) {
        t0 = hal_time_us();
        radio_disable_rxen();
        timing->disable_us += hal_time_us() - t0;
        timing->disable_count++;
    } else {
        NRF_RADIO->TASKS_RXEN = 1;
    }

    if (wait_ready) {
        NRF_RADIO->EVENTS_READY = 0;
        t0 = hal_time_us();
        if (!radio_wait_event(&NRF_RADIO->EVENTS_READY, RADIO_EVENT_TIMEOUT_US)) {
            timing->ready_us += hal_time_us() - t0;
            timing->ready_count++;
            return (int8_t)-127;
        }
        timing->ready_us += hal_time_us() - t0;
        timing->ready_count++;
    }

    t0 = hal_time_us();
    wait_us(SCAN_SETTLE_US);
    timing->settle_us += hal_time_us() - t0;

    t0 = hal_time_us();
    const int8_t rssi = radio_rssi_sample();
    timing->rssi_us += hal_time_us() - t0;
    return rssi;
}

#endif

void hal_timer_init(void)
{
    HAL_TIMER->MODE = TIMER_MODE_MODE_Timer;
    HAL_TIMER->BITMODE = TIMER_BITMODE_BITMODE_24Bit;
    HAL_TIMER->PRESCALER = 4;
    HAL_TIMER->TASKS_CLEAR = 1;
    HAL_TIMER->TASKS_START = 1;
}

uint32_t hal_time_us(void)
{
    HAL_TIMER->TASKS_CAPTURE[0] = 1;
    return HAL_TIMER->CC[0];
}

void hal_radio_init(void)
{
#if !NRFSCAN_SOC_NRF54
    NRF_RADIO->POWER = RADIO_POWER_POWER_Disabled << RADIO_POWER_POWER_Pos;
    NRF_RADIO->POWER = RADIO_POWER_POWER_Enabled << RADIO_POWER_POWER_Pos;
#endif

    NRF_RADIO->SHORTS = 0;

#if NRFSCAN_SOC_NRF54
    /* radio_reset() + radio_phy_set() for nRF54LX (Zephyr BLE controller). */
    NRF_RADIO->PCNF1 = RADIO_PCNF1_RESET;
    NRF_RADIO->TIMING =
        (RADIO_TIMING_RU_Fast << RADIO_TIMING_RU_Pos) & RADIO_TIMING_RU_Msk;
#endif

    /* lll_test: 8-bit length, no whitening in test mode. */
    NRF_RADIO->PCNF0 =
        (((1UL) << RADIO_PCNF0_S0LEN_Pos) & RADIO_PCNF0_S0LEN_Msk) |
        (((8UL) << RADIO_PCNF0_LFLEN_Pos) & RADIO_PCNF0_LFLEN_Msk);

    NRF_RADIO->PCNF1 =
        (((RADIO_PCNF1_ENDIAN_Little) << RADIO_PCNF1_ENDIAN_Pos) & RADIO_PCNF1_ENDIAN_Msk) |
        (((3UL) << RADIO_PCNF1_BALEN_Pos) & RADIO_PCNF1_BALEN_Msk) |
        (((0UL) << RADIO_PCNF1_STATLEN_Pos) & RADIO_PCNF1_STATLEN_Msk) |
        ((((uint32_t)DD_MAX_PAYLOAD_LENGTH) << RADIO_PCNF1_MAXLEN_Pos) & RADIO_PCNF1_MAXLEN_Msk);
#if !NRFSCAN_SOC_NRF54
    NRF_RADIO->PCNF1 |=
        ((RADIO_PCNF1_WHITEEN_Enabled << RADIO_PCNF1_WHITEEN_Pos) & RADIO_PCNF1_WHITEEN_Msk);
#endif

    NRF_RADIO->CRCPOLY = CRC_POLYNOMIAL_INIT_SETTINGS;
    NRF_RADIO->CRCCNF = (((RADIO_CRCCNF_SKIPADDR_Skip) << RADIO_CRCCNF_SKIPADDR_Pos) &
                         RADIO_CRCCNF_SKIPADDR_Msk) |
                        (((RADIO_CRCCNF_LEN_Three) << RADIO_CRCCNF_LEN_Pos) & RADIO_CRCCNF_LEN_Msk);

    NRF_RADIO->RXADDRESSES = (RADIO_RXADDRESSES_ADDR0_Enabled << RADIO_RXADDRESSES_ADDR0_Pos);
    NRF_RADIO->MODE = RADIO_MODE_SCAN & RADIO_MODE_MODE_Msk;
    NRF_RADIO->TIFS = 150;

#if NRFSCAN_SOC_NRF54
    NRF_RADIO->TXPOWER =
        (RADIO_TXPOWER_TXPOWER_0dBm << RADIO_TXPOWER_TXPOWER_Pos) & RADIO_TXPOWER_TXPOWER_Msk;
#endif

    NRF_RADIO->PREFIX0 = access_address[3];
    NRF_RADIO->BASE0 = (((uint32_t)access_address[2]) << 24) | (((uint32_t)access_address[1]) << 16) |
                       (((uint32_t)access_address[0]) << 8);

    NRF_RADIO->CRCINIT = ((uint32_t)crc_seed[0]) | ((uint32_t)crc_seed[1]) << 8 |
                         ((uint32_t)crc_seed[2]) << 16;

#if NRFSCAN_SOC_NRF54
    NRF_RADIO->INTENCLR00 = 0xFFFFFFFF;
#else
    NRF_RADIO->INTENCLR = 0xFFFFFFFF;
#endif
}

void hal_radio_scan_rssi(int8_t *rssi_dbm, hal_radio_scan_timing_t *timing)
{
    timing->disable_us = 0;
    timing->ready_us = 0;
    timing->settle_us = 0;
    timing->rssi_us = 0;
    timing->final_disable_us = 0;
    timing->disable_count = 0;
    timing->ready_count = 0;

    NRF_RADIO->PACKETPTR = (uint32_t)rx_packet;

#if NRFSCAN_SOC_NRF54
    radio_constlat_enable();
    for (uint8_t idx = 0; idx < RSSI_CHANNEL_COUNT; idx++) {
        const uint8_t ch = (uint8_t)(idx * RSSI_FREQ_STEP_MHZ);

        rssi_dbm[idx] = radio_measure_channel_nrf54(ch, timing);
    }
#else
    for (uint8_t idx = 0; idx < RSSI_CHANNEL_COUNT; idx++) {
        const uint8_t ch = (uint8_t)(idx * RSSI_FREQ_STEP_MHZ);
        const bool disable_first = (SCAN_DISABLE_PERIOD_CH > 0) && (idx > 0) &&
                                   ((idx % SCAN_DISABLE_PERIOD_CH) == 0);
        const bool wait_ready = (idx == 0) || disable_first;

        rssi_dbm[idx] = radio_measure_channel(ch, disable_first, wait_ready, timing);
    }
#endif

    const uint32_t t0 = hal_time_us();
    NRF_RADIO->EVENTS_DISABLED = 0;
    NRF_RADIO->TASKS_DISABLE = 1;
    (void)radio_wait_event(&NRF_RADIO->EVENTS_DISABLED, RADIO_EVENT_TIMEOUT_US);
    timing->final_disable_us = hal_time_us() - t0;
}
```

## src/hal_radio.h
```c
#ifndef HAL_RADIO_H__
#define HAL_RADIO_H__

#include <stdint.h>

#ifndef SCAN_RADIO_2MBIT
#define SCAN_RADIO_2MBIT 1
#endif

#define RSSI_FREQ_BASE_MHZ 2400

#if SCAN_RADIO_2MBIT
/** BLE 2 Mbps PHY: 40 bins, 2 MHz steps -> 2400..2478 MHz (FREQUENCY 0,2,..78) */
#define RSSI_FREQ_STEP_MHZ 2
#define RSSI_CHANNEL_COUNT 40
#else
/** BLE 1 Mbps PHY: 80 bins, 1 MHz steps -> 2400..2479 MHz (FREQUENCY 0..79) */
#define RSSI_FREQ_STEP_MHZ 1
#define RSSI_CHANNEL_COUNT 80
#endif

/** Cumulative microseconds inside hal_radio_scan_rssi (scan timer). */
typedef struct {
    uint32_t hfclk_us;
    uint32_t disable_us;
    uint32_t ready_us;
    uint32_t settle_us;
    uint32_t rssi_us;
    uint32_t final_disable_us;
    uint16_t disable_count;
    uint16_t ready_count;
} hal_radio_scan_timing_t;

void hal_timer_init(void);
uint32_t hal_time_us(void);
void hal_radio_init(void);
void hal_radio_scan_rssi(int8_t *rssi_dbm, hal_radio_scan_timing_t *timing);

#endif
```

## src/hal_radio_common.c
```c
/*********************************************************************
 *  Shared radio helpers and packet setup (all SoCs).
 ********************************************************************/

#include "hal_radio_internal.h"
#include "hal_platform.h"
#include "hal_soc.h"
#include <mdk/nrf.h>

#define CRC_POLYNOMIAL_INIT_SETTINGS ((0x5B << 0) | (0x06 << 8) | (0x00 << 16))

static const uint8_t access_address[4] = {0xD6, 0xBE, 0x89, 0x8E};
static const uint8_t crc_seed[3] = {0x55, 0x55, 0x55};

static uint8_t rx_packet[HAL_RADIO_MAX_PAYLOAD_LENGTH];

void hal_radio_wait_us(uint32_t us)
{
    uint32_t start = hal_time_us();

    while ((uint32_t)(hal_time_us() - start) < us) {
    }
}

bool hal_radio_wait_event(volatile uint32_t *event, uint32_t timeout_us)
{
    uint32_t start = hal_time_us();

    while (*event == 0) {
        if ((uint32_t)(hal_time_us() - start) > timeout_us) {
            return false;
        }
    }
    *event = 0;
    return true;
}

void hal_radio_channel_set(uint8_t channel_index)
{
    NRF_RADIO->FREQUENCY = channel_index;
}

int8_t hal_radio_rssi_sample_dbm(void)
{
    uint8_t sample = (uint8_t)((NRF_RADIO->RSSISAMPLE & RADIO_RSSISAMPLE_RSSISAMPLE_Msk) >>
                               RADIO_RSSISAMPLE_RSSISAMPLE_Pos);
    return (int8_t)(-(int8_t)sample);
}

void hal_radio_base_init(void)
{
    NRF_RADIO->SHORTS = 0;

    /* lll_test: 8-bit length; SoC files choose whitening. */
    NRF_RADIO->PCNF0 =
        (((1UL) << RADIO_PCNF0_S0LEN_Pos) & RADIO_PCNF0_S0LEN_Msk) |
        (((8UL) << RADIO_PCNF0_LFLEN_Pos) & RADIO_PCNF0_LFLEN_Msk);

    NRF_RADIO->PCNF1 =
        (((RADIO_PCNF1_ENDIAN_Little) << RADIO_PCNF1_ENDIAN_Pos) & RADIO_PCNF1_ENDIAN_Msk) |
        (((3UL) << RADIO_PCNF1_BALEN_Pos) & RADIO_PCNF1_BALEN_Msk) |
        (((0UL) << RADIO_PCNF1_STATLEN_Pos) & RADIO_PCNF1_STATLEN_Msk) |
        ((((uint32_t)HAL_RADIO_MAX_PAYLOAD_LENGTH) << RADIO_PCNF1_MAXLEN_Pos) &
         RADIO_PCNF1_MAXLEN_Msk);

    NRF_RADIO->CRCPOLY = CRC_POLYNOMIAL_INIT_SETTINGS;
    NRF_RADIO->CRCCNF = (((RADIO_CRCCNF_SKIPADDR_Skip) << RADIO_CRCCNF_SKIPADDR_Pos) &
                         RADIO_CRCCNF_SKIPADDR_Msk) |
                        (((RADIO_CRCCNF_LEN_Three) << RADIO_CRCCNF_LEN_Pos) & RADIO_CRCCNF_LEN_Msk);

    NRF_RADIO->RXADDRESSES = (RADIO_RXADDRESSES_ADDR0_Enabled << RADIO_RXADDRESSES_ADDR0_Pos);
    NRF_RADIO->MODE = HAL_RADIO_MODE_SCAN & RADIO_MODE_MODE_Msk;
    NRF_RADIO->TIFS = 150;

    NRF_RADIO->PREFIX0 = access_address[3];
    NRF_RADIO->BASE0 = (((uint32_t)access_address[2]) << 24) | (((uint32_t)access_address[1]) << 16) |
                       (((uint32_t)access_address[0]) << 8);

    NRF_RADIO->CRCINIT = ((uint32_t)crc_seed[0]) | ((uint32_t)crc_seed[1]) << 8 |
                         ((uint32_t)crc_seed[2]) << 16;
}

void hal_radio_scan_begin(hal_radio_scan_timing_t *timing, int8_t *rssi_dbm)
{
    (void)rssi_dbm;

    timing->hfclk_us = 0;
    timing->disable_us = 0;
    timing->ready_us = 0;
    timing->settle_us = 0;
    timing->rssi_us = 0;
    timing->final_disable_us = 0;
    timing->disable_count = 0;
    timing->ready_count = 0;

    const uint32_t t0 = hal_time_us();
    hal_clock_hfclk_start();
    timing->hfclk_us = hal_time_us() - t0;

    NRF_RADIO->PACKETPTR = (uint32_t)rx_packet;
}

void hal_radio_scan_end(hal_radio_scan_timing_t *timing)
{
    const uint32_t t0 = hal_time_us();

    NRF_RADIO->EVENTS_DISABLED = 0;
    NRF_RADIO->TASKS_DISABLE = 1;
    (void)hal_radio_wait_event(&NRF_RADIO->EVENTS_DISABLED, HAL_RADIO_EVENT_TIMEOUT_US);
    timing->final_disable_us = hal_time_us() - t0;
}

void hal_timer_init(void)
{
    HAL_TIMER->MODE = TIMER_MODE_MODE_Timer;
    HAL_TIMER->BITMODE = TIMER_BITMODE_BITMODE_24Bit;
    HAL_TIMER->PRESCALER = 4;
    HAL_TIMER->TASKS_CLEAR = 1;
    HAL_TIMER->TASKS_START = 1;
}

uint32_t hal_time_us(void)
{
    HAL_TIMER->TASKS_CAPTURE[0] = 1;
    return HAL_TIMER->CC[0];
}

void hal_radio_scan_rssi(int8_t *rssi_dbm, hal_radio_scan_timing_t *timing)
{
    hal_radio_scan_begin(timing, rssi_dbm);
    hal_radio_scan_channels(rssi_dbm, timing);
    hal_radio_scan_end(timing);
    hal_clock_hfclk_stop();
}
```

## src/hal_radio_internal.h
```c
#ifndef HAL_RADIO_INTERNAL_H__
#define HAL_RADIO_INTERNAL_H__

#include "hal_radio.h"
#include <mdk/nrf.h>
#include <stdbool.h>
#include <stdint.h>

#define HAL_RADIO_MAX_PAYLOAD_LENGTH (31 + 6)
#define HAL_RADIO_EVENT_TIMEOUT_US   2000u

#ifndef SCAN_SETTLE_US
#define SCAN_SETTLE_US 10
#endif

#ifndef SCAN_DISABLE_PERIOD_CH
#define SCAN_DISABLE_PERIOD_CH 10
#endif

#if SCAN_RADIO_2MBIT
#define HAL_RADIO_MODE_SCAN ((RADIO_MODE_MODE_Ble_2Mbit) << RADIO_MODE_MODE_Pos)
#else
#define HAL_RADIO_MODE_SCAN ((RADIO_MODE_MODE_Ble_1Mbit) << RADIO_MODE_MODE_Pos)
#endif

void hal_radio_wait_us(uint32_t us);
bool hal_radio_wait_event(volatile uint32_t *event, uint32_t timeout_us);
void hal_radio_channel_set(uint8_t channel_index);
int8_t hal_radio_rssi_sample_dbm(void);
int8_t hal_radio_rssi_sample(void);

void hal_radio_base_init(void);
void hal_radio_scan_begin(hal_radio_scan_timing_t *timing, int8_t *rssi_dbm);
void hal_radio_scan_channels(int8_t *rssi_dbm, hal_radio_scan_timing_t *timing);
void hal_radio_scan_end(hal_radio_scan_timing_t *timing);

#endif
```

## src/hal_radio_nrf52.c
```c
/*********************************************************************
 *  nRF52 RSSI sweep: periodic DISABLE+RXEN, RSSIEND.
 ********************************************************************/

#include "hal_radio_internal.h"
#include <mdk/nrf.h>

#define RADIO_SHORTS_HOP (RADIO_SHORTS_DISABLED_RXEN_Enabled << RADIO_SHORTS_DISABLED_RXEN_Pos)

static void radio_disable_rxen(void)
{
    NRF_RADIO->SHORTS = RADIO_SHORTS_HOP;
    NRF_RADIO->EVENTS_DISABLED = 0;
    NRF_RADIO->TASKS_DISABLE = 1;
    (void)hal_radio_wait_event(&NRF_RADIO->EVENTS_DISABLED, HAL_RADIO_EVENT_TIMEOUT_US);
    NRF_RADIO->SHORTS = 0;
}

int8_t hal_radio_rssi_sample(void)
{
    NRF_RADIO->EVENTS_RSSIEND = 0;
    NRF_RADIO->TASKS_RSSISTART = 1;
    if (!hal_radio_wait_event(&NRF_RADIO->EVENTS_RSSIEND, HAL_RADIO_EVENT_TIMEOUT_US)) {
        return (int8_t)-127;
    }
    return hal_radio_rssi_sample_dbm();
}

void hal_radio_init(void)
{
    NRF_RADIO->POWER = RADIO_POWER_POWER_Disabled << RADIO_POWER_POWER_Pos;
    NRF_RADIO->POWER = RADIO_POWER_POWER_Enabled << RADIO_POWER_POWER_Pos;

    hal_radio_base_init();

    NRF_RADIO->DATAWHITEIV = 0;
    NRF_RADIO->PCNF1 |=
        ((RADIO_PCNF1_WHITEEN_Enabled << RADIO_PCNF1_WHITEEN_Pos) & RADIO_PCNF1_WHITEEN_Msk);
    NRF_RADIO->INTENCLR = 0xFFFFFFFF;
}

static int8_t radio_measure_channel(uint8_t channel, bool disable_first, bool wait_ready,
                                    hal_radio_scan_timing_t *timing)
{
    uint32_t t0;

    hal_radio_channel_set(channel);
    NRF_RADIO->DATAWHITEIV = 0;

    if (disable_first) {
        t0 = hal_time_us();
        radio_disable_rxen();
        timing->disable_us += hal_time_us() - t0;
        timing->disable_count++;
    } else {
        NRF_RADIO->TASKS_RXEN = 1;
    }

    if (wait_ready) {
        NRF_RADIO->EVENTS_READY = 0;
        t0 = hal_time_us();
        if (!hal_radio_wait_event(&NRF_RADIO->EVENTS_READY, HAL_RADIO_EVENT_TIMEOUT_US)) {
            timing->ready_us += hal_time_us() - t0;
            timing->ready_count++;
            return (int8_t)-127;
        }
        timing->ready_us += hal_time_us() - t0;
        timing->ready_count++;
    }

    t0 = hal_time_us();
    hal_radio_wait_us(SCAN_SETTLE_US);
    timing->settle_us += hal_time_us() - t0;

    t0 = hal_time_us();
    const int8_t rssi = hal_radio_rssi_sample();
    timing->rssi_us += hal_time_us() - t0;
    return rssi;
}

void hal_radio_scan_channels(int8_t *rssi_dbm, hal_radio_scan_timing_t *timing)
{
    for (uint8_t idx = 0; idx < RSSI_CHANNEL_COUNT; idx++) {
        const uint8_t ch = (uint8_t)(idx * RSSI_FREQ_STEP_MHZ);
        const bool disable_first = (SCAN_DISABLE_PERIOD_CH > 0) && (idx > 0) &&
                                   ((idx % SCAN_DISABLE_PERIOD_CH) == 0);
        const bool wait_ready = (idx == 0) || disable_first;

        rssi_dbm[idx] = radio_measure_channel(ch, disable_first, wait_ready, timing);
    }
}
```

## src/hal_radio_nrf54.c
```c
/*********************************************************************
 *  nRF54 RSSI sweep: PLLEN reload per bin (nRF54LM20-class radio).
 ********************************************************************/

#include "hal_radio_internal.h"
#include <mdk/nrf.h>

#define RADIO_SHORTS_PLL_HOP                                                                   \
    (RADIO_SHORTS_PLLREADY_RXEN_Enabled << RADIO_SHORTS_PLLREADY_RXEN_Pos)
#define RADIO_DATAWHITE_IV  0x00890040UL
#define RADIO_PCNF1_RESET   0x00000000UL
#define RADIO_PLLREADY_TIMEOUT_US 150u
#define RADIO_RXREADY_TIMEOUT_US  150u
#define RADIO_SETTLE_US           SCAN_SETTLE_US
#define RADIO_RSSI_SAMPLES          3u

static void radio_constlat_enable(void)
{
    //NRF_POWER->TASKS_CONSTLAT = 1;
}

static void radio_channel_set_nrf54(uint8_t channel_index)
{
    hal_radio_channel_set(channel_index);
    
    //NRF_RADIO->DATAWHITE = RADIO_DATAWHITE_IV;
}

static int8_t radio_rssi_sample_max(void)
{
    NRF_RADIO->TASKS_RSSISTART = 1;
    const int8_t rssi = hal_radio_rssi_sample_dbm();
    return rssi;
}

int8_t hal_radio_rssi_sample(void)
{
    return radio_rssi_sample_max();
}

void hal_radio_init(void)
{
    /* radio_reset() + radio_phy_set() for nRF54LX (Zephyr BLE controller). */
    NRF_RADIO->PCNF1 = RADIO_PCNF1_RESET;
    NRF_RADIO->TIMING =
        (RADIO_TIMING_RU_Fast << RADIO_TIMING_RU_Pos) & RADIO_TIMING_RU_Msk;

    hal_radio_base_init();

    NRF_RADIO->TXPOWER =
        (RADIO_TXPOWER_TXPOWER_0dBm << RADIO_TXPOWER_TXPOWER_Pos) & RADIO_TXPOWER_TXPOWER_Msk;
    NRF_RADIO->INTENCLR00 = 0xFFFFFFFF;

}

static bool radio_pll_reload_rxen(hal_radio_scan_timing_t *timing)
{
    uint32_t t0;

    NRF_RADIO->SHORTS = RADIO_SHORTS_PLL_HOP;
    NRF_RADIO->EVENTS_PLLREADY = 0;
    NRF_RADIO->EVENTS_RXREADY = 0;

    t0 = hal_time_us();
    NRF_RADIO->TASKS_PLLEN = 1;
    if (!hal_radio_wait_event(&NRF_RADIO->EVENTS_RXREADY, RADIO_PLLREADY_TIMEOUT_US)) {
        NRF_RADIO->SHORTS = 0;
        timing->ready_us += hal_time_us() - t0;
        timing->ready_count++;
        return false;
    }
    timing->ready_us += hal_time_us() - t0;
    timing->ready_count++;

    return true;
}

static int8_t radio_measure_channel(uint8_t channel, hal_radio_scan_timing_t *timing)
{
    uint32_t t0;

    radio_channel_set_nrf54(channel);


    if (!radio_pll_reload_rxen(timing)) {
        return (int8_t)-127;
    }


    t0 = hal_time_us();
    const int8_t rssi = hal_radio_rssi_sample();
    timing->rssi_us += hal_time_us() - t0;


    return rssi;
}

void hal_radio_scan_channels(int8_t *rssi_dbm, hal_radio_scan_timing_t *timing)
{

        hal_radio_channel_set(0);
    radio_constlat_enable();
    NRF_RADIO->TASKS_PLLEN = 0x1;
    hal_radio_wait_us(40);
    NRF_RADIO->TASKS_START = 1;
    hal_radio_wait_us(5);

    for (uint8_t idx = 0; idx < RSSI_CHANNEL_COUNT; idx++) {
        const uint8_t ch = (uint8_t)(idx * RSSI_FREQ_STEP_MHZ);

        rssi_dbm[idx] = radio_measure_channel(ch, timing);
    }
    NRF_RADIO->TASKS_STOP = 1;

}
```

## src/hal_soc.h
```c
#ifndef HAL_SOC_H__
#define HAL_SOC_H__

#ifndef NRFSCAN_SOC_NRF54
#define NRFSCAN_SOC_NRF54 0
#endif

#if NRFSCAN_SOC_NRF54
/* DK USB VCOM is wired to uart20 / NRF_UARTE20 on P1.04 (TX) and P1.05 (RX). */
#define HAL_UARTE_INST NRF_UARTE20
#define HAL_TIMER      NRF_TIMER21
#ifndef TXD_PIN
#define TXD_PIN 36 /* NRF_PIN_PORT_TO_PIN_NUMBER(4, 1) */
#endif
#ifndef RXD_PIN
#define RXD_PIN 37 /* NRF_PIN_PORT_TO_PIN_NUMBER(5, 1) */
#endif
#else
#define HAL_UARTE_INST NRF_UARTE0
#define HAL_TIMER      NRF_TIMER1
#ifndef TXD_PIN
#define TXD_PIN 6
#endif
#ifndef RXD_PIN
#define RXD_PIN 8
#endif
#endif

#endif
```
